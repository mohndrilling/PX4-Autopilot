## src/examples/mohntech_example_app/Kconfig
```kconfig
menuconfig EXAMPLES_MOHNTECH_EXAMPLE_APP
	bool "mohntech_example_app"
	default n
	---help---
		Enable support for mohntech_example_app
```

## src/examples/test_app/Kconfig
```kconfig
menuconfig EXAMPLES_TEST_APP
    bool "PX4_Simple_app"
    default n
    ---help---
        Enable PX4 simple app
```
